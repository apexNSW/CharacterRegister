#define SHIFT_DATA 2
#define SHIFT_CLK 3
#define SHIFT_LATCH 4
#define WRITE_ENABLE 13
#define EEPROM_D0 5
#define EEPROM_D1 6
#define EEPROM_D2 7
#define EEPROM_D3 8
#define EEPROM_D4 9
#define EEPROM_D5 10
#define EEPROM_D6 11
#define EEPROM_D7 12

#define R0 0x000
#define R1 0x100
#define R2 0x200
#define R3 0x300
#define R4 0x400
#define R5 0x500
#define R6 0x600
#define R7 0x700

word rows[] = {
  R0,
  R1,
  R2,
  R3,
  R4,
  R5,
  R6,
  R7  
};

byte hexCharacters[][9] = {
  {0x00,0x00,0x00,0x00,0x00,0x00,0x00,0x00,0x00}, //null
  {0x05,0x00,0x7c,0x82,0x82,0x82,0x44,0xaa,0xee}, //Ω
  {0x06,0x00,0x00,0x00,0x6c,0x92,0x6c,0x00,0x00}, //∞
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  {0x7f,0x00,0x00,0x00,0x00,0x00,0x00,0x00,0x00}  //blank
};

int DATAMODE = 0;//1 for read (0 for write)

void setup() {
  pinMode(SHIFT_DATA,OUTPUT);
  pinMode(SHIFT_CLK,OUTPUT);
  pinMode(SHIFT_LATCH,OUTPUT);
  digitalWrite(WRITE_ENABLE,HIGH);
  pinMode(WRITE_ENABLE,OUTPUT);
  dataPinsOff();
  pinsWrite(true);
  Serial.begin(9600);
  //eraseEEPROM(0);  //erase all data from the EEPROM
  progChars(); //program all characters from hexCharacters array
  delay(1000);
  readEEPROM(0); //read EEPROM
}
void loop() {

}
void progChars() {
  for(int i=0; i<(sizeof(hexCharacters)/sizeof(hexCharacters[0]));i++) {
    for(int j=0; j<8;j++) {
      word address = hexCharacters[i][0] | rows[j];
      writeData(hexCharacters[i][j+1],address);
    }
  }
  Serial.print("EEPROM programmed.");
}
void eraseEEPROM(bool val) {
  byte data;
  if (val) {
    data = 0xff;
  } else {
    data = 0x00;
  }
  for(int i = 0; i<2048; i++) {
    writeData(data,i);
  }
  Serial.println("EEPROM Erased.");
  
}
void readEEPROM(int startaddress) {
  int endaddress = startaddress+255;
  for(int base = startaddress; base <= endaddress; base += 16) {
    byte data[16];
    for(int offset = 0; offset <=15; offset +=1) {
      data[offset] = readData(base+offset);
    }
    char buf[80];
    sprintf(buf,"%03x: %02x %02x %02x %02x %02x %02x %02x %02x  %02x %02x %02x %02x %02x %02x %02x %02x",
      base, data[0], data[1], data[2], data[3], data[4], data[5],
      data[6], data[7], data[8], data[9], data[10], data[11], data[12],
      data[13], data[14], data[15]
    );
    Serial.println(buf);
  }
}
byte readData(word address) {
  pinsRead();
  set_register(address,true);
  byte data = 0;
  int ct = 0;
  for(int pin=EEPROM_D0;pin<=EEPROM_D7;pin++) {
    bitWrite(data, ct, digitalRead(pin));
    ct++;
  }
  return data;
}
void writeData(byte data, word address) {
  pinsWrite();
  set_register(address,false);
  int ct = 0;
  for(int pin=EEPROM_D7;pin>=EEPROM_D0;pin--) {
     digitalWrite(pin,bitRead(data,ct));
     ct++;
  }
  /*
  for(int pin=EEPROM_D0;pin<=EEPROM_D7;pin++) {
     digitalWrite(pin,bitRead(data,ct));
     ct++;
  }
  */
  writePulse();
}
void writePulse() {
  digitalWrite(WRITE_ENABLE,LOW);
  delayMicroseconds(1);
  digitalWrite(WRITE_ENABLE,HIGH);
  delay(10);
  dataPinsOff();
}
void dataPinsOff() {
  if (DATAMODE == 0) {
    for(int pin=EEPROM_D0;pin<=EEPROM_D7;pin++) {
      digitalWrite(pin,LOW);
    }
  }
}
void set_register(word address, bool outputEnable) {
  byte left = highByte(address);
  byte right = lowByte(address);
  if (outputEnable) {
    bitClear(left,7);
  } else {
    bitSet(left,7);
  }
  shiftOut(SHIFT_DATA,SHIFT_CLK,MSBFIRST,left);
  shiftOut(SHIFT_DATA,SHIFT_CLK,MSBFIRST,right);
  latch();
}
void pinsRead(bool init) {
  int proceed = 0;
  if (init) {
    proceed = 1;
  } else {
    if (DATAMODE == 0) {
      proceed = 1;
    }
  }
  if (proceed) {
    for(int pin=EEPROM_D0;pin<=EEPROM_D7;pin++) {
      pinMode(pin,INPUT);
    }
    DATAMODE = 1;
  }
}
void pinsWrite(bool init) {
  int proceed = 0;
  if (init) {
    proceed = 1;
  } else {
    if (DATAMODE == 1) {
      proceed = 1;
    }
  }
  if (proceed) {
    for(int pin=EEPROM_D0;pin<=EEPROM_D7;pin++) {
      pinMode(pin,OUTPUT);
    }
    DATAMODE = 0;
  }
}
void pinsWrite() {
  pinsWrite(false);
}
void pinsRead() {
  pinsRead(false);
}
void latch() {
  digitalWrite(SHIFT_LATCH,LOW);
  digitalWrite(SHIFT_LATCH,HIGH);
  digitalWrite(SHIFT_LATCH,LOW);
}
